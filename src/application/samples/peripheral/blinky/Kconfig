## src/application/samples/peripheral/blinky/Kconfig
```kconfig
#===============================================================================
# @brief    Kconfig file.
# Copyright (c) HiSilicon (Shanghai) Technologies Co., Ltd. 2024-2024. All rights reserved.
#===============================================================================
config SAMPLE_BLINKY_PIN
    int
    prompt "Choose BLINKY pin."
    depends on SAMPLE_SUPPORT_BLINKY
    default 29
```
